## drivers/xshm/Kconfig
```kconfig
#
# XSHM (external shared memory) support
#
config XSHM
	depends on C2C
	default n
	tristate

config XSHM_CHR
	tristate "Character device for External Shared Memory (XSHM)"
	select XSHM
	default n
	---help---
	Say "Y" if you want to character device for External Shared
	Memory (XSHM) IPC mechanism. XSHM is an IPC protocol used to
	talk to external device such as modem over a shared memory
	(e.g. Chip to Chip).
	Only say "M" here if you want to test XSHM and needs to load
	and unload its module.
	If unsure say N.

config  XSHM_DEBUG
	bool "Enable Debug"
	depends on XSHM
	default n
	--- help ---
	Enable the inclusion of debug code in the XSHM module.
	Be aware that doing this will impact performance.
	If unsure say N.
```

## kernel/time/Kconfig
```kconfig
#
# Timer subsystem related configuration options
#

# Core internal switch. Selected by NO_HZ / HIGH_RES_TIMERS. This is
# only related to the tick functionality. Oneshot clockevent devices
# are supported independ of this.
config TICK_ONESHOT
	bool

config NO_HZ
	bool "Tickless System (Dynamic Ticks)"
	depends on !ARCH_USES_GETTIMEOFFSET && GENERIC_CLOCKEVENTS
	select TICK_ONESHOT
	help
	  This option enables a tickless system: timer interrupts will
	  only trigger on an as-needed basis both when the system is
	  busy and when the system is idle.

config HIGH_RES_TIMERS
	bool "High Resolution Timer Support"
	depends on !ARCH_USES_GETTIMEOFFSET && GENERIC_CLOCKEVENTS
	select TICK_ONESHOT
	help
	  This option enables high resolution timer support. If your
	  hardware is not capable then this option only increases
	  the size of the kernel image.

config GENERIC_CLOCKEVENTS_BUILD
	bool
	default y
	depends on GENERIC_CLOCKEVENTS

config GENERIC_CLOCKEVENTS_MIN_ADJUST
	bool

config ALARMTIMER_DEV_NAME
	string "Alarmtime RTC wakeup"
	depends on RTC_CLASS
	help
	  The RTC you specify here will be used by the alarmtimer framework
	  to wakeup from suspend. If only one RTC exist leave
	  it blank. This config is used to choose if several RTC exists.

	  If unsure, leave it blank. The first registerd RTC will then be used.
```

## sound/soc/ux500/Kconfig
```kconfig
#
# Ux500 SoC audio configuration
#

menuconfig SND_SOC_UX500
	bool "SoC Audio support for Ux500 platform"
	depends on SND_SOC
	default n
	help
		Say Y if you want to add support for the Ux500 platform.

choice
	prompt "Platform 5500/85X0"
	depends on SND_SOC_UX500
	default SND_SOC_U85X0
	config SND_SOC_U85X0
	bool "Platform - U85X0"
	config SND_SOC_U5500
	bool "Platform - U5500"
endchoice

config SND_SOC_UX500_AB850X
	bool "Codec - AB850X"
	depends on SND_SOC_UX500 && UX500_SOC_DB8500 && AB8500_CORE && AB8500_GPADC
	select SND_SOC_AB850X
	default n
	help
		Say Y if you want to include AB850X audio codec.

config SND_SOC_UX500_AB8540
	bool "Codec - AB8540"
	depends on SND_SOC_UX500 && UX500_SOC_DB8500 && AB8500_CORE && AB8500_GPADC
	select SND_SOC_AB8540
	default n
	help
		Say Y if you want to include AB8540 audio codec.

config SND_SOC_UX500_CG29XX
	bool "Codec - CG29xx"
	depends on SND_SOC_UX500 && (UX500_SOC_DB8500) && CG2900_AUDIO
	select SND_SOC_CG29XX
	default n
	help
		Say Y if you want to include CG29xx codec (Combo chip).

config SND_SOC_UX500_AV8100
	bool "Codec - AV8100"
	depends on SND_SOC_UX500 && (UX500_SOC_DB8500) && AV8100
	select SND_SOC_AV8100
	default n
	help
		Say Y if you want to include AV8100 codec (HDMI chip).

config SND_SOC_UX500_DEBUG
	bool "Activate Ux500 platform debug-mode (pr_debug)"
	depends on SND_SOC_UX500
	default n
	help
		Say Y if you want to add debug level prints for Ux500 code-files.
```
