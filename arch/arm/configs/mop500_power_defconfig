## arch/arm/configs/palladium_x540_defconfig
```kconfig
CONFIG_EXPERIMENTAL=y
# CONFIG_LOCALVERSION_AUTO is not set
CONFIG_SYSVIPC=y
CONFIG_BSD_PROCESS_ACCT=y
CONFIG_LOG_BUF_SHIFT=18
CONFIG_CGROUPS=y
CONFIG_CGROUP_CPUACCT=y
CONFIG_RELAY=y
CONFIG_BLK_DEV_INITRD=y
CONFIG_KALLSYMS_ALL=y
CONFIG_ASHMEM=y
CONFIG_EMBEDDED=y
CONFIG_PERF_EVENTS=y
CONFIG_SLAB=y
CONFIG_BOOTTIME=y
CONFIG_MODULES=y
CONFIG_MODULE_UNLOAD=y
CONFIG_MODVERSIONS=y
CONFIG_MODULE_SRCVERSION_ALL=y
# CONFIG_BLK_DEV_BSG is not set
CONFIG_DEFAULT_DEADLINE=y
CONFIG_ARCH_U8500=y
CONFIG_UX500_SOC_DB8500=y
CONFIG_MACH_U9540=y
CONFIG_MACH_PALLADIUM9540=y
CONFIG_MACH_U8540=y
CONFIG_DBX500_PRCMU_DEBUG=y
# CONFIG_UX500_DB_DUMP is not set
# CONFIG_UX500_HW_OBSERVER is not set
CONFIG_UX500_SUSPEND=y
CONFIG_UX500_SUSPEND_STANDBY=y
CONFIG_UX500_SUSPEND_MEM=y
CONFIG_UX500_SUSPEND_DBG=y
CONFIG_UX500_SUSPEND_DBG_WAKE_ON_UART=y
CONFIG_NO_HZ=y
CONFIG_HIGH_RES_TIMERS=y
CONFIG_SMP=y
CONFIG_NR_CPUS=2
CONFIG_PREEMPT=y
CONFIG_AEABI=y
# CONFIG_OABI_COMPAT is not set
CONFIG_HIGHMEM=y
CONFIG_CMDLINE="root=/dev/ram0 init=init rw console=ttyAMA2,115200n8 mem=256M initrd=0x800000,72M"
CONFIG_KEXEC=y
CONFIG_CRASH_SWRESET=y
CONFIG_CRASH_DUMP=y
CONFIG_CPU_FREQ=y
CONFIG_CPU_FREQ_STAT_DETAILS=y
CONFIG_CPU_IDLE=y
CONFIG_DBX500_CPUIDLE_DEEPEST_STATE=3
CONFIG_DBX500_CPUIDLE_DEBUG=y
CONFIG_VFP=y
# CONFIG_CORE_DUMP_DEFAULT_ELF_HEADERS is not set
CONFIG_WAKELOCK=y
CONFIG_PM_RUNTIME=y
CONFIG_NET=y
CONFIG_PACKET=y
CONFIG_UNIX=y
CONFIG_NET_KEY=y
CONFIG_INET=y
CONFIG_IP_MULTICAST=y
CONFIG_IP_ADVANCED_ROUTER=y
CONFIG_IP_MULTIPLE_TABLES=y
CONFIG_IP_PNP=y
CONFIG_IP_PNP_DHCP=y
# CONFIG_INET_LRO is not set
CONFIG_IPV6=y
# CONFIG_INET6_XFRM_MODE_TRANSPORT is not set
# CONFIG_INET6_XFRM_MODE_TUNNEL is not set
# CONFIG_INET6_XFRM_MODE_BEET is not set
# CONFIG_IPV6_SIT is not set
CONFIG_IPV6_MULTIPLE_TABLES=y
CONFIG_NETFILTER=y
CONFIG_NETFILTER_NETLINK_QUEUE=y
CONFIG_NETFILTER_NETLINK_LOG=y
CONFIG_NF_CONNTRACK=y
CONFIG_NF_CONNTRACK_FTP=y
CONFIG_NF_CT_NETLINK=y
CONFIG_NETFILTER_TPROXY=y
CONFIG_NETFILTER_XT_MATCH_MULTIPORT=y
CONFIG_NETFILTER_XT_MATCH_QTAGUID=y
CONFIG_NETFILTER_XT_MATCH_SOCKET=y
CONFIG_NETFILTER_XT_MATCH_STATE=y
CONFIG_NF_CONNTRACK_IPV4=y
CONFIG_IP_NF_IPTABLES=y
CONFIG_IP_NF_FILTER=y
CONFIG_IP_NF_TARGET_ULOG=y
CONFIG_NF_NAT=y
CONFIG_IP_NF_TARGET_MASQUERADE=y
CONFIG_IP_NF_MANGLE=y
CONFIG_IP6_NF_IPTABLES=y
CONFIG_PHONET=y
# CONFIG_WIRELESS is not set
CONFIG_RFKILL=y
CONFIG_RFKILL_INPUT=y
CONFIG_CAIF=y
CONFIG_UEVENT_HELPER_PATH="/sbin/hotplug"
# CONFIG_STANDALONE is not set
CONFIG_BLK_DEV_LOOP=y
CONFIG_BLK_DEV_RAM=y
CONFIG_BLK_DEV_RAM_SIZE=73728
CONFIG_MISC_DEVICES=y
# CONFIG_ANDROID_PMEM is not set
CONFIG_UID_STAT=y
CONFIG_HWMEM=y
CONFIG_SCSI=y
CONFIG_BLK_DEV_SD=y
CONFIG_MD=y
CONFIG_BLK_DEV_DM=y
CONFIG_DM_CRYPT=y
CONFIG_DM_UEVENT=y
CONFIG_NETDEVICES=y
CONFIG_TUN=y
CONFIG_SMSC_PHY=y
CONFIG_NET_ETHERNET=y
CONFIG_SMSC911X=y
# CONFIG_NETDEV_1000 is not set
# CONFIG_NETDEV_10000 is not set
# CONFIG_WLAN is not set
CONFIG_USB_USBNET=y
CONFIG_USB_NET_DM9601=y
CONFIG_PPP=y
CONFIG_PPP_ASYNC=y
CONFIG_PPP_MPPE=y
CONFIG_PPPOLAC=y
CONFIG_PPPOPNS=y
# CONFIG_INPUT_MOUSEDEV is not set
CONFIG_INPUT_EVDEV=y
# CONFIG_INPUT_KEYBOARD is not set
# CONFIG_INPUT_MOUSE is not set
# CONFIG_VT is not set
# CONFIG_LEGACY_PTYS is not set
# CONFIG_DEVKMEM is not set
CONFIG_SERIAL_AMBA_PL011=y
CONFIG_SERIAL_AMBA_PL011_CONSOLE=y
CONFIG_SERIAL_AMBA_PL011_CLOCK_CONTROL=y
CONFIG_I2C=y
CONFIG_I2C_CHARDEV=y
CONFIG_I2C_NOMADIK=y
CONFIG_SPI=y
# CONFIG_STM_MSP_SPI is not set
CONFIG_SPI_PL022=y
CONFIG_GPIO_SYSFS=y
CONFIG_POWER_SUPPLY=y
CONFIG_WATCHDOG=y
CONFIG_UX500_WATCHDOG_DEBUG=y
# CONFIG_ABX500_CORE is not set
CONFIG_MFD_DB8500_PRCMU=y
CONFIG_MFD_DBX540_PRCMU=y
CONFIG_REGULATOR=y
CONFIG_REGULATOR_DEBUG=y
CONFIG_REGULATOR_FIXED_VOLTAGE=y
CONFIG_REGULATOR_VIRTUAL_CONSUMER=y
CONFIG_REGULATOR_DB8500_PRCMU=y
CONFIG_GPU_MALI=y
CONFIG_HIDRAW=y
CONFIG_USB=y
# CONFIG_USB_DEVICE_CLASS is not set
CONFIG_USB_SUSPEND=y
# CONFIG_USB_OTG_WHITELIST is not set
CONFIG_USB_MON=y
CONFIG_USB_MUSB_HDRC=y
CONFIG_USB_MUSB_UX500=y
CONFIG_USB_MUSB_OTG=y
CONFIG_USB_GADGET_MUSB_HDRC=y
CONFIG_USB_ACM=y
CONFIG_USB_STORAGE=y
CONFIG_USB_LIBUSUAL=y
CONFIG_USB_GADGET=y
CONFIG_USB_GADGET_VBUS_DRAW=500
CONFIG_USB_G_ANDROID=y
CONFIG_USB_ANDROID_PHONET=y
CONFIG_MMC=y
CONFIG_MMC_UNSAFE_RESUME=y
CONFIG_MMC_PARANOID_SD_INIT=y
CONFIG_MMC_BLOCK_MINORS=32
# CONFIG_MMC_BLOCK_BOUNCE is not set
CONFIG_MMC_ARMMMCI=y
CONFIG_NEW_LEDS=y
CONFIG_LEDS_CLASS=y
CONFIG_LEDS_LM3530=y
CONFIG_LEDS_LP5521=y
CONFIG_LEDS_TRIGGERS=y
CONFIG_LEDS_TRIGGER_TIMER=y
CONFIG_SWITCH=y
CONFIG_RTC_CLASS=y
CONFIG_RTC_ALARM_DEV_NAME="pl031"
CONFIG_RTC_DRV_PL031=y
CONFIG_DMADEVICES=y
CONFIG_STE_DMA40=y
CONFIG_STAGING=y
CONFIG_ANDROID=y
CONFIG_ANDROID_BINDER_IPC=y
CONFIG_ANDROID_LOGGER=y
CONFIG_ANDROID_RAM_CONSOLE=y
CONFIG_ANDROID_TIMED_GPIO=y
CONFIG_ANDROID_LOW_MEMORY_KILLER=y
# CONFIG_MODEM is not set
CONFIG_EXT4_FS=y
CONFIG_EXT4_FS_POSIX_ACL=y
CONFIG_QUOTA=y
CONFIG_QFMT_V2=y
CONFIG_TMPFS=y
CONFIG_TMPFS_POSIX_ACL=y
# CONFIG_MISC_FILESYSTEMS is not set
CONFIG_CIFS=y
CONFIG_CIFS_XATTR=y
CONFIG_CIFS_POSIX=y
CONFIG_PARTITION_ADVANCED=y
CONFIG_BLKDEV_PARTITION=y
# CONFIG_MSDOS_PARTITION is not set
CONFIG_RPMB_PARTITION=y
CONFIG_NLS_CODEPAGE_437=y
CONFIG_NLS_ISO8859_1=y
CONFIG_PRINTK_TIME=y
CONFIG_MAGIC_SYSRQ=y
CONFIG_UNUSED_SYMBOLS=y
CONFIG_DEBUG_KERNEL=y
CONFIG_LOCKUP_DETECTOR=y
CONFIG_DETECT_HUNG_TASK=y
CONFIG_SCHEDSTATS=y
CONFIG_TIMER_STATS=y
# CONFIG_DEBUG_PREEMPT is not set
CONFIG_DEBUG_SPINLOCK_SLEEP=y
CONFIG_DEBUG_INFO=y
CONFIG_SYSCTL_SYSCALL_CHECK=y
CONFIG_FUNCTION_TRACER=y
CONFIG_DYNAMIC_DEBUG=y
CONFIG_DEBUG_USER=y
CONFIG_KEYS=y
CONFIG_CRYPTO_AES=y
CONFIG_CRYPTO_TWOFISH=y
# CONFIG_CRYPTO_ANSI_CPRNG is not set
CONFIG_CRYPTO_DEV_UX500=y
CONFIG_CRYPTO_DEV_UX500_HASH=y
CONFIG_CRC7=y
CONFIG_AVERAGE=y
```

## arch/arm/mach-ux500/Kconfig
```kconfig
if ARCH_U8500

config UX500_SOC_COMMON
	bool
	default y
	select ARM_GIC
	select PINCTRL
	select PINCTRL_NOMADIK
	select PL310_ERRATA_753970
	select ARM_ERRATA_754322
	select ARM_ERRATA_764369
	select SYS_SOC
	select HAS_MTU
	select SOC_BUS

config UX500_SOC_DBX500
	depends on UX500_SOC_DB8500
	bool

menu "Ux500 SoC"

config UX500_SOC_DB8500
	bool "DB8500"
	select UX500_SOC_DBX500
	select PINCTRL_DB8500

endmenu

menu "Ux500 target platform (boards)"

config MACH_UX500
	bool "Ux500 Development platform"
	depends on UX500_SOC_DB8500

config MACH_U8500
	bool "U8500 Development platform"
	depends on UX500_SOC_DB8500
	select MACH_UX500
	help
	  Include support for the mop500 development platform.

config MACH_HREFV60
	bool "U85000 Development platform, HREFv60 version"
	depends on UX500_SOC_DB8500
	select MACH_U8500
	help
	  Include support for the HREFv60 new development platform.

config MACH_A9500
	bool "A9500 Development platform"
	depends on UX500_SOC_DB8500
	select MACH_U8500
	help
          Include support for the 9500 development platform.

config MACH_U8520
	bool "U8520 Development platform"
	depends on UX500_SOC_DB8500
	select MACH_U8500
	select UIB
	help
	  Include support for the 8520 development platform.

config MACH_SNOWBALL
	bool "U8500 Snowball platform"
	depends on UX500_SOC_DB8500
	select MACH_U8500
	select UIB
	help
	  Include support for the snowball development platform.

config MACH_U9540
	bool "U9540 Development platform"
	depends on UX500_SOC_DB8500
	select MACH_UX500
	help
	  Include support for the U9540 development platform.

choice
	prompt "U9540 board type"
	depends on MACH_U9540
	default MACH_CCU9540

config MACH_CCU9540
	bool "CCU9540 Development platform"
	select UIB
	help
	 Include support for the ccu9540 development platform.

config MACH_PALLADIUM9540
	bool "Palladium 9540 virtual platform"
	help
	 Include support for the Palladium 9540 virtual platform.

endchoice

config MACH_U8540
	bool "U8540 Development platform"
	depends on UX500_SOC_DB8500
	select MACH_UX500
	select PINCTRL_DB8540
	help
	  Include support for the U8540 development platform.

choice
	prompt "U8540 board type"
	depends on MACH_U8540
	default MACH_CCU8540

config MACH_CCU8540
	bool "CCU8540 Development platform"
	select UIB
	help
	 Include support for the ccu8540 development platform.

config MACH_PALLADIUM8540
	bool "Palladium 8540 virtual platform"
	help
	 Include support for the Palladium 8540 virtual platform.

endchoice

config MACH_UX500_DT
	bool "Generic U8500 support using device tree"
	depends on MACH_U8500
	select USE_OF

endmenu

menu "User Interface Board"

config UIB
	bool "User Interface Board (UIB) support"
	help
	  Include support for the Universal Board Support

choice
	prompt "Ux500 UIB Keylayout"
	depends on UIB
	default KEYLAYOUT_LAYOUT1

config KEYLAYOUT_LAYOUT1
	bool "UIB Keylayout 1; for generic users"
	help
	  Supported keylayout for some numerics, power/call buttons,
	  volume control etc

config KEYLAYOUT_LAYOUT2
	bool "UIB Keylayout 2; for connectivity users"
	help
	  Supports keylayout numerics 0-9, left/right/up/down/back/
	  enter keys and special character "."(dot)

endchoice

endmenu

choice
	prompt "DBx500 sched_clock"

config DBX500_SCHED_CLOCK_PRCMU
	bool "PRCMU Timer sched_clock"
	depends on CLKSRC_DBX500_PRCMU
	select CLKSRC_DBX500_PRCMU_SCHED_CLOCK
	help
	  Use the always on PRCMU Timer as sched_clock

config DBX500_MTU_SCHED_CLOCK
	bool "MTU sched_clock"
	depends on HAS_MTU
	select NOMADIK_MTU_SCHED_CLOCK
	help
	  Use the Multi Timer Unit as the sched_clock.

endchoice

config UX500_DEBUG_UART
	int "Ux500 UART to use for low-level debug"
	default 2
	help
	  Choose the UART on which kernel low-level debug messages should be
	  output.

config UX500_GPIO_KEYS
        bool "Use gpio-keys for proximity and hal sensors"
        depends on KEYBOARD_GPIO
        help
	  Add proximity and hal sensors as a gpio keyboard.

config DBX500_PRCMU_DEBUG
	bool "DBX500 PRCMU debug"
	depends on ((MFD_DB8500_PRCMU || MFD_DBX540_PRCMU) && DEBUG_FS)
	help
	  Add support for PRCMU debug

config TEE_UX500
	bool "Trusted Execution Environment (TEE) ux500 hardware support"
	depends on TEE_SUPPORT && HWMEM
	default y
	help
	  Adds TEE hardware support for ux500 platforms.

config DB8500_MLOADER
	bool "Modem firmware upload/download support"
	depends on UX500_SOC_DB8500
	select DBX500_MLOADER
	help
	  Adds Modem firmware upload/download support to DB8500.

config UX500_DEBUG_HWREG
	bool "Debug hardware registers from userspace"
	depends on (DEBUG_FS && UX500_SOC_DB8500)
	help
	  Adds various debug files to access registers.
	  This should never ever be used for anything else than debugging.

config UX500_DEBUG_NO_LAUTERBACH
       bool "Disable clocks needed for Lauterbach debugging"
       help
	  Disable clocks needed for Lauterbach debugging at boot.
	  If yes, you will reduce the power consumption.

config UX500_L2X0_PREFETCH_CTRL
	bool "PL310 prefetch control"
	depends on (UX500_SOC_DB8500) && \
			(TEE_UX500 && CACHE_L2X0)
	default y
	help
	  Adds interface to control instruction and data prefetch.
	  Communication with Trustzone is done through TEE driver.

config UX500_ROMCODE_SHARED_MUTEX
	bool "ROMCODE Shared Mutex Configuration"
	depends on UX500_SOC_DB8500 && TEE_UX500
	default y
	help
	  Add interface to configure shared mutex used for L2 cache maintenance
	  inside RomCode, to prevent dead lock while exiting DeepSleep/DeepIdle/Hotplug.
	  Communication with Trustzone is done through TEE driver.

config UX500_PRCMU_CPU_HOTPLUG
	bool "PRCMU CPU Hotplug feature"
	depends on UX500_ROMCODE_SHARED_MUTEX
	default n
	help
	  Add interface to enable/disable PRCMUFw CPU Hotplug feature

config UX500_DB_DUMP
	bool "DBx500 register dump on crash"
	depends on (UX500_SOC_DB8500)
	default y
	help
	  Reads specific DBx500 register in case of kernel crash
	  and saves it.

config RTC_HCTOHC
	bool "Set 2nd RTC from 1st RTC at startup and resume"
	depends on (UX500_SOC_DB8500 && RTC_HCTOSYS && RTC_DRV_PL031)
	default y
	help
	  If you say yes here, the 2nd RTC will be set using
	  the value read from the 1st RTC device. This is useful when
	  the 1st RTC is battery backed but not the 2nd.

config UX500_HW_OBSERVER
	bool "Add debug IF for HW Observer"
	depends on (DEBUG_FS || UX500_SOC_DB8500)
	default y
	help
	  Add interface to configure Hw Observer lines.

config U8500_CUSTOM_RF
	bool "Custom RF for 8500"
	help
	  Say Y here if the board does not use 8500 RF to provide sysclk.  This
	  will disable the use of the SWAT protocol on the sysclkreqout line.

config U9540_MLOADER
	bool "Enable u9540 MLoader support"
	help
	  Adds support of MLoader as platform device.

source "arch/arm/mach-ux500/Kconfig-arch"
source "arch/arm/mach-ux500/pm/Kconfig"
source "arch/arm/mach-ux500/test/Kconfig"

endif
```

## drivers/gpu/ion/Kconfig
```kconfig
menuconfig ION
	tristate "Ion Memory Manager"
	select GENERIC_ALLOCATOR
	select DMA_SHARED_BUFFER
	help
	  Chose this option to enable the ION Memory Manager.

config ION_TEGRA
	tristate "Ion for Tegra"
	depends on ARCH_TEGRA && ION
	help
	  Choose this option if you wish to use ion on an nVidia Tegra.

config ION_UX500
	tristate "Ion for ux500"
	depends on ARCH_U8500 && ION
	help
	  Choose this option if you wish to use ion on ux500 platforms.
```

## drivers/hsi/controllers/Kconfig
```kconfig
#
# HSI controllers configuration
#
comment "HSI controllers"

config STE_HSI
       tristate "STE HSI controller driver"
       depends on (ARCH_U8500 || ARCH_NOMADIK) && HSI
       default n
       help
         ST-Ericsson HSI controller.
         If you say Y here, you will enable the U8500 HSI hardware driver.

         If unsure, say N.

config STE_HSI_DEEP_DEBUG
	bool "STE HSI Deep Debug"
	depends on (STE_HSI && DEEP_DEBUG)
	default y
	help
	  Deep Debug interface provides an access to STE HSI registers.
	  It allows to read or write directly a register.
	  Say Y to include support for Deep Debug.
	  If unsure, say N.

config OMAP_SSI
	tristate "OMAP SSI hardware driver"
	depends on ARCH_OMAP && HSI
	default n
	---help---
	  SSI is a legacy version of HSI. It is usually used to connect
	  an application engine with a cellular modem.
	  If you say Y here, you will enable the OMAP SSI hardware driver.

	  If unsure, say N.

if OMAP_SSI

config OMAP_SSI_CONFIG
	boolean
	default y

endif # OMAP_SSI
```

## drivers/staging/hva/Kconfig
```kconfig
config STE_HVA
       tristate "ST-Ericsson HVA (Hardware Video Accelerator) driver"
       help
         This is the HVA driver. The Hardware Video Accelerator is a
         hardware subsystem dedicated to video decoding and encoding.
```

## drivers/staging/hx170dec/Kconfig
```kconfig
config HX170_DEC
	bool "ST-Ericsson HX170 multiformat video decoder"
	depends on MFD_DBX540_PRCMU
	help
		Say Y here enable hx170 (aka G1) multiformat video decoder.
```

## drivers/staging/pasr/Kconfig
```kconfig
config ARCH_HAS_PASR
	bool

config PASR
	bool "DDR Partial Array Self-Refresh"
	depends on ARCH_HAS_PASR
	---help---
	  PASR Frameworks brings support for the Partial Array Self-Refresh DDR
	  power management feature. PASR has been introduced in LP-DDR2, and is
	  also present in DDR3.
	  The role of this framework is to stop the refresh of unused memory to
	  enhance DDR power consumption.

config PASR_ENABLE
	bool "Enable PASR"
	def_bool n
	depends on PASR

config PASR_DEBUG
	bool "Add PASR debug prints"
	def_bool n
	depends on PASR

config UX500_PASR
	bool "Ux500 Family PASR driver"
	def_bool y
	depends on (PASR_ENABLE && UX500_SOC_DB8500)

config PASR_SYSFS
	bool "Enable PASR sysfs"
	def_bool y
	depends on PASR_ENABLE

config PASR_DEBUGFS
	bool "Enable PASR debugfs"
	def_bool n
	depends on PASR_ENABLE
```
